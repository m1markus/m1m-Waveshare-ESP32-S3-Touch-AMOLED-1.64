// Generated by LCD Wizard

#include "app_logic.h"
#include "src/ui/ui.h"
#include "hardware.h"
#include "lw_math.h"
#include <stdio.h>
#include <string.h>

void vars_update(bool force)
{
    (void)force;
    // no variables defined yet
}

// Whether a widget already reads pre + s + post, without building it.
static inline bool lw_text_is(const char * cur, const char * pre, const char * s, const char * post)
{
    if (!cur) return false;
    size_t a = strlen(pre), b = strlen(s), c = strlen(post);
    return strlen(cur) == a + b + c && strncmp(cur, pre, a) == 0
        && strncmp(cur + a, s, b) == 0 && strcmp(cur + a + b, post) == 0;
}

void bindings_apply(void)
{
    char buf[66];   // a number and the longest prefix and postfix
    (void)buf;
    if (ui_Gauge != NULL && ui_Dial != NULL) {
        lv_arc_set_value(ui_Gauge, (int32_t)lroundf((float)lv_slider_get_value(ui_Dial)));
    }
    if (ui_Readout != NULL && ui_Dial != NULL) {
        snprintf(buf, sizeof(buf), "%d %%", (int)((float)lv_slider_get_value(ui_Dial)));
        {
            const char * cur = lv_label_get_text(ui_Readout);
            if (!cur || strcmp(cur, buf) != 0) lv_label_set_text(ui_Readout, buf);
        }
    }
}

void app_init(void)
{
    hw_refresh_now();
    vars_update(true);
    bindings_apply();
}

void app_poll(void)
{
    uint32_t now = millis();
    hw_poll(now);

    // Refresh variables and the widgets bound to them at a steady rate.
    static uint32_t next_refresh = 0;
    if ((int32_t)(now - next_refresh) >= 0) {
        next_refresh = now + 100;
        vars_update(false);
        bindings_apply();
    }
}
