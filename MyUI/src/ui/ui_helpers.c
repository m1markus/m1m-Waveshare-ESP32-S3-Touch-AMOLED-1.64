// Generated by LCD Wizard - shared helpers for generated event code

#include "ui_helpers.h"
#include <stdio.h>

void _ui_flag_modify(lv_obj_t * target, int32_t flag, int value)
{
    if (target == NULL) return;
    switch (value) {
        case _UI_MODIFY_FLAG_ADD:    lv_obj_add_flag(target, (lv_obj_flag_t)flag); break;
        case _UI_MODIFY_FLAG_REMOVE: lv_obj_remove_flag(target, (lv_obj_flag_t)flag); break;
        case _UI_MODIFY_FLAG_TOGGLE:
            if (lv_obj_has_flag(target, (lv_obj_flag_t)flag)) lv_obj_remove_flag(target, (lv_obj_flag_t)flag);
            else lv_obj_add_flag(target, (lv_obj_flag_t)flag);
            break;
    }
}

void _ui_screen_change(lv_obj_t ** target, lv_scr_load_anim_t fademode, int spd, int delay, void (*target_init)(void))
{
    if (*target == NULL) target_init();
    lv_scr_load_anim(*target, fademode, spd, delay, false);
}

void _ui_screen_delete(lv_obj_t ** target)
{
    if (*target == NULL) return;
    lv_obj_del(*target);
    *target = NULL;
}

#if LV_USE_ARC
void _ui_arc_increment(lv_obj_t * target, int val)
{
    if (target == NULL) return;
    lv_arc_set_value(target, lv_arc_get_value(target) + val);
    lv_obj_send_event(target, LV_EVENT_VALUE_CHANGED, NULL);
}
#endif

#if LV_USE_SLIDER
void _ui_slider_increment(lv_obj_t * target, int val, lv_anim_enable_t anm)
{
    if (target == NULL) return;
    lv_slider_set_value(target, lv_slider_get_value(target) + val, anm);
    lv_obj_send_event(target, LV_EVENT_VALUE_CHANGED, NULL);
}
#endif

#if LV_USE_BAR
void _ui_bar_increment(lv_obj_t * target, int val, lv_anim_enable_t anm)
{
    if (target == NULL) return;
    lv_bar_set_value(target, lv_bar_get_value(target) + val, anm);
}
#endif

#if LV_USE_ARC
void _ui_arc_set_text_value(lv_obj_t * trg, lv_obj_t * src, const char * prefix, const char * postfix)
{
    char buf[64];
    if (trg == NULL || src == NULL) return;
    snprintf(buf, sizeof(buf), "%s%d%s", prefix, (int)lv_arc_get_value(src), postfix);
    lv_label_set_text(trg, buf);
}
#endif

#if LV_USE_SLIDER
void _ui_slider_set_text_value(lv_obj_t * trg, lv_obj_t * src, const char * prefix, const char * postfix)
{
    char buf[64];
    if (trg == NULL || src == NULL) return;
    snprintf(buf, sizeof(buf), "%s%d%s", prefix, (int)lv_slider_get_value(src), postfix);
    lv_label_set_text(trg, buf);
}
#endif

void _ui_checked_set_text_value(lv_obj_t * trg, lv_obj_t * src, const char * txt_on, const char * txt_off)
{
    if (trg == NULL || src == NULL) return;
    lv_label_set_text(trg, lv_obj_has_state(src, LV_STATE_CHECKED) ? txt_on : txt_off);
}

void _ui_switch_theme(bool dark)
{
    lv_display_t * d = lv_display_get_default();
    lv_theme_t * th = lv_theme_default_init(d, lv_color_hex(0x2196F3), lv_color_hex(0xEF6C00), dark, &lv_font_montserrat_14);
    lv_display_set_theme(d, th);
}

void _ui_anim_callback_set_opacity(void * obj, int32_t v)
{
    lv_obj_set_style_opa((lv_obj_t *)obj, (lv_opa_t)v, LV_PART_MAIN | LV_STATE_DEFAULT);
}

void _ui_anim_callback_set_zoom(void * obj, int32_t v)
{
    lv_obj_set_style_transform_scale((lv_obj_t *)obj, v, LV_PART_MAIN | LV_STATE_DEFAULT);
}

void _ui_anim_callback_set_angle(void * obj, int32_t v)
{
    lv_obj_set_style_transform_rotation((lv_obj_t *)obj, v, LV_PART_MAIN | LV_STATE_DEFAULT);
}
