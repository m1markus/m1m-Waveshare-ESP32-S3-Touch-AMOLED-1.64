// Generated by LCD Wizard

#include "hardware.h"
#include "lcd_pins.h"
#include "lw_math.h"

// ---- device instances ----
SensorQMI8658 per_IMU;

static bool per_IMU_present = false;
static uint32_t per_IMU_next = 0;
static float per_IMU_accelX_cache = 0.0f;
static float per_IMU_accelY_cache = 0.0f;
static float per_IMU_accelZ_cache = 0.0f;
static float per_IMU_gyroX_cache = 0.0f;
static float per_IMU_gyroY_cache = 0.0f;
static float per_IMU_gyroZ_cache = 0.0f;
static float per_IMU_temperature_cache = 0.0f;
static bool per_SDCard_present = false;
static uint32_t per_SDCard_next = 0;
static float per_SDCard_cardSize_cache = 0.0f;
static float per_SDCard_usedBytes_cache = 0.0f;
static int32_t ain_Battery_rawv = 0;
static float ain_Battery_smooth = -1.0f;
static float ain_Battery_scaled = 0.0f;
static uint32_t ain_Battery_next = 0;
static bool din_BOOTButton_state = false;
static bool din_BOOTButton_raw = false;
static uint32_t din_BOOTButton_since = 0;

float ain_Battery_value(void) { return ain_Battery_scaled; }
int32_t ain_Battery_raw(void) { return ain_Battery_rawv; }
bool din_BOOTButton_active(void) { return din_BOOTButton_state; }
bool per_IMU_ok(void) { return per_IMU_present; }
float per_IMU_accelX(void) { return per_IMU_accelX_cache; }
float per_IMU_accelY(void) { return per_IMU_accelY_cache; }
float per_IMU_accelZ(void) { return per_IMU_accelZ_cache; }
float per_IMU_gyroX(void) { return per_IMU_gyroX_cache; }
float per_IMU_gyroY(void) { return per_IMU_gyroY_cache; }
float per_IMU_gyroZ(void) { return per_IMU_gyroZ_cache; }
float per_IMU_temperature(void) { return per_IMU_temperature_cache; }
bool per_SDCard_ok(void) { return per_SDCard_present; }
float per_SDCard_cardSize(void) { return per_SDCard_cardSize_cache; }
float per_SDCard_usedBytes(void) { return per_SDCard_usedBytes_cache; }

void hw_init_early(void)
{
    static bool done = false;
    if (done) return;
    done = true;

    // I2C (GPIO 47 / 48)
    Wire.begin(47, 48, 400000);
    Wire.setTimeout(5);   // the Stream timeout: a refused read is not waited for
    // SPI (TF card)
    SPI.begin(41, 40, 39, -1);
}

void hw_init(void)
{
    hw_init_early();

    // deselect every SPI device before the first transaction
    pinMode(38, OUTPUT);
    digitalWrite(38, HIGH);

    (void)analogRead(4);   // attach the pin to the ADC
    analogSetPinAttenuation(4, ADC_11db);
    analogReadResolution(12);

    pinMode(0, INPUT_PULLUP);

    // IMU is disabled in the designer
    // SDCard is disabled in the designer

    hw_refresh_now();
}

static void hw_read_analog(uint32_t now, bool force)
{
    if (force || (int32_t)(now - ain_Battery_next) >= 0) {
        ain_Battery_next = now + 2000;
        uint32_t acc = 0;
        for (uint8_t i = 0; i < 8; i++) acc += analogRead(4);
        int32_t raw = (int32_t)(acc / 8);
        // exponential smoothing, alpha = 0.2. The first reading is taken as it is.
        ain_Battery_smooth = (ain_Battery_smooth < 0.0f) ? (float)raw : (0.200f * (float)raw) + (0.800f * ain_Battery_smooth);
        ain_Battery_rawv = (int32_t)lroundf(ain_Battery_smooth);
        ain_Battery_scaled = _lw_mapf((float)ain_Battery_rawv, 0.0f, 4095.0f, 0.0f, 9.9f);
    }
}

static void hw_read_digital(uint32_t now, bool force)
{
    {
        bool now_raw = !(digitalRead(0));
        if (now_raw != din_BOOTButton_raw) { din_BOOTButton_raw = now_raw; din_BOOTButton_since = now; }
        if (force || (uint32_t)(now - din_BOOTButton_since) >= 25u) {
            din_BOOTButton_state = din_BOOTButton_raw;
        }
    }
}

static void hw_read_peripherals(uint32_t now, bool force)
{
    if (per_IMU_present && (force || (int32_t)(now - per_IMU_next) >= 0)) {
        per_IMU_next = now + 1000;
        float per_IMU_ax = per_IMU_accelX_cache, per_IMU_ay = per_IMU_accelY_cache, per_IMU_az = per_IMU_accelZ_cache;
        float per_IMU_gx = per_IMU_gyroX_cache, per_IMU_gy = per_IMU_gyroY_cache, per_IMU_gz = per_IMU_gyroZ_cache;
        int16_t per_IMU_r[3];
        if (per_IMU.readAccelRaw(per_IMU_r[0], per_IMU_r[1], per_IMU_r[2])) { float k = per_IMU.getAccelScale(); per_IMU_ax = per_IMU_r[0] * k; per_IMU_ay = per_IMU_r[1] * k; per_IMU_az = per_IMU_r[2] * k; }
        if (per_IMU.readGyroRaw(per_IMU_r[0], per_IMU_r[1], per_IMU_r[2])) { float k = per_IMU.getGyroScale(); per_IMU_gx = per_IMU_r[0] * k; per_IMU_gy = per_IMU_r[1] * k; per_IMU_gz = per_IMU_r[2] * k; }
        float per_IMU_tc = per_IMU.getTemperature();
        if (per_IMU_tc != per_IMU_tc) per_IMU_tc = per_IMU_temperature_cache;
        per_IMU_accelX_cache = (float)(per_IMU_ax);
        per_IMU_accelY_cache = (float)(per_IMU_ay);
        per_IMU_accelZ_cache = (float)(per_IMU_az);
        per_IMU_gyroX_cache = (float)(per_IMU_gx);
        per_IMU_gyroY_cache = (float)(per_IMU_gy);
        per_IMU_gyroZ_cache = (float)(per_IMU_gz);
        per_IMU_temperature_cache = (float)(per_IMU_tc);
    }
    if (per_SDCard_present && (force || (int32_t)(now - per_SDCard_next) >= 0)) {
        per_SDCard_next = now + 5000;
        per_SDCard_cardSize_cache = (float)((int32_t)(SD.cardSize() / (1024 * 1024)));
        per_SDCard_usedBytes_cache = (float)((int32_t)(SD.usedBytes() / (1024 * 1024)));
    }
}

void hw_poll(uint32_t now)
{
    hw_read_analog(now, false);
    hw_read_digital(now, false);
    hw_read_peripherals(now, false);
}

void hw_refresh_now(void)
{
    uint32_t now = millis();
    hw_read_analog(now, true);
    hw_read_digital(now, true);
    hw_read_peripherals(now, true);
}
