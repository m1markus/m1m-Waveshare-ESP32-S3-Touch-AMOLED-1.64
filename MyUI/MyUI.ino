/*
 * MyUI - generated by LCD Wizard (https://lcdwizard.com)
 *
 * Target : ESP32-S3
 * Board  : Waveshare ESP32-S3-Touch-AMOLED-1.64 V1.1
 * Panel  : CO5300  280x456  (QSPI)
 * Touch  : FT3168 / FT6146
 * Driver : GFX Library for Arduino
 * LVGL   : 9.x
 */

#include <Arduino.h>
#include <esp_log.h>
#include <lvgl.h>
#include "lcd_pins.h"
#include "src/ui/ui.h"
#include "hardware.h"
#include "app_logic.h"
#include "touch.h"

#include <Arduino_GFX_Library.h>
#if !__has_include(<Arduino_OLED.h>)
#error "GFX Library for Arduino is older than 1.6.1, and this panel needs a newer one: update it to 1.6.9 in the Library Manager (or remove the old copy from your sketchbook's libraries folder). See LIBRARIES.md."
#endif

Arduino_DataBus *bus = new Arduino_ESP32QSPI(
    LCD_CS, LCD_SCK, LCD_D0, LCD_D1, LCD_D2, LCD_D3);

Arduino_GFX *gfx = new Arduino_CO5300(
    bus, LCD_RST, 0 /* rotation */,
    280, 456 /* the glass, as the controller addresses it */,
    LCD_COL_OFFSET, LCD_ROW_OFFSET, LCD_COL_OFFSET2, LCD_ROW_OFFSET2);

// ---- LVGL draw buffer ----
#define DRAW_BUF_LINES 40
#define DRAW_BUF_SIZE  (LCD_H_RES * DRAW_BUF_LINES * (LV_COLOR_DEPTH / 8))
static uint8_t *draw_buf_1 = NULL;
static uint8_t *draw_buf_2 = NULL;
static lv_display_t *display = NULL;

// ---- brightness (the panel's own: command 0x51, 0-100 %) ----
// An AMOLED has no backlight pin: a Set backlight action sets this instead.
static uint8_t backlight_level = LCD_BL_DEFAULT;
static bool backlight_told = false;   // whether the panel has been sent a level yet
uint8_t backlight_get(void) { return backlight_level; }

void backlight_set(uint8_t percent)
{
    if (percent > 100) percent = 100;
    if (backlight_told && percent == backlight_level) return;   // it holds this already
    backlight_level = percent;
    backlight_told = true;
    bus->beginWrite();
    bus->writeC8D8(0x51, (uint8_t)(percent * 255 / 100));
    bus->endWrite();
}

static void backlight_init(void)
{
    backlight_set(LCD_BL_DEFAULT);
}

// ---- display flush ----
static void disp_flush(lv_display_t *disp_drv, const lv_area_t *area, uint8_t *px_map)
{
    uint32_t w = (area->x2 - area->x1 + 1);
    uint32_t h = (area->y2 - area->y1 + 1);
    gfx->draw16bitRGBBitmap(area->x1, area->y1, (uint16_t *)px_map, w, h);
    lv_display_flush_ready(disp_drv);
}

// ---- rounder ----
// The CO5300 takes a window only if it starts and ends on a multiple
// of 2, so every area LVGL redraws is widened to that both ways.
static void disp_rounder(lv_event_t *e)
{
    lv_area_t *a = (lv_area_t *)lv_event_get_param(e);
    a->x1 -= a->x1 % 2;
    a->x2 += 1 - a->x2 % 2;
    a->y1 -= a->y1 % 2;
    a->y2 += 1 - a->y2 % 2;
}

static uint32_t lw_tick_ms(void) { return (uint32_t)millis(); }

void setup()
{
    // Only this program speaks on the serial port: ESP-IDF's own messages are off.
    esp_log_level_set("*", ESP_LOG_NONE);
    Serial.begin(115200);
    #if ARDUINO_USB_CDC_ON_BOOT && ESP_ARDUINO_VERSION_MAJOR >= 3
    // Serial is the chip's own USB. With a PC attached and nothing reading
    // the port, every print would wait for it - and so would the UI. A
    // print waits a millisecond at most, and a line nobody is reading is
    // dropped after 20 of them.
    Serial.setTxTimeoutMs(1);
    #endif
    delay(100);
    Serial.println("MyUI starting...");
    if (!psramFound()) {
        Serial.println("PSRAM: none found, though this design is set for 8 MB of octal PSRAM. Check the module has it, and that it is on and octal in the board's settings (Arduino IDE: Tools > PSRAM).");
    }

    // ---- panel ----
    if (!gfx->begin()) {
        Serial.println("panel: gfx->begin() failed, so the screen will stay dark - check the panel's pins and its controller on the Display tab.");
    }
    gfx->fillScreen(0x0000);  // black
    backlight_init();   // the panel's own brightness: the Display tab's Default %

    touch_hw_init();

    // ---- LVGL ----
    lv_init();
    lv_tick_set_cb(lw_tick_ms);

    size_t draw_buf_size = DRAW_BUF_SIZE;
    draw_buf_1 = (uint8_t *)malloc(draw_buf_size);
    draw_buf_2 = (uint8_t *)malloc(draw_buf_size);
    if (!draw_buf_1 || !draw_buf_2) {
        free(draw_buf_1);
        free(draw_buf_2);
        draw_buf_2 = NULL;
        draw_buf_size = (DRAW_BUF_SIZE / DRAW_BUF_LINES) * (DRAW_BUF_LINES >= 4 ? DRAW_BUF_LINES / 4 : 1);
        draw_buf_1 = (uint8_t *)malloc(draw_buf_size);
        Serial.printf("draw buffer: %u lines did not fit, so one buffer of %u lines is used and the screen redraws more slowly - lower Buffer height in Project settings.\n",
                      (unsigned)DRAW_BUF_LINES, (unsigned)(DRAW_BUF_LINES >= 4 ? DRAW_BUF_LINES / 4 : 1));
        if (!draw_buf_1) {
            Serial.println("draw buffer: not even that fits, so nothing can be drawn - lower Buffer height in Project settings.");
            while (1) delay(1000);
        }
    }

    display = lv_display_create(SCREEN_WIDTH, SCREEN_HEIGHT);
    lv_display_set_flush_cb(display, disp_flush);
    lv_display_set_buffers(display, draw_buf_1, draw_buf_2, draw_buf_size, LV_DISPLAY_RENDER_MODE_PARTIAL);
    lv_display_add_event_cb(display, disp_rounder, LV_EVENT_INVALIDATE_AREA, NULL);

    touch_lvgl_init();

    // ---- peripherals and discrete I/O ----
    hw_init();

    ui_init();
    app_init();
    Serial.println("UI ready");
}

void loop()
{
    app_poll();
    lv_timer_handler();
    delay(5);
}
